## config/west.yml
```yaml
manifest:
  remotes:
    - name: zmkfirmware
      url-base: https://github.com/zmkfirmware
    - name: englmaxi
      url-base: https://github.com/englmaxi
    - name: a741725193
      url-base: https://github.com/a741725193
  projects:
    - name: zmk
      remote: zmkfirmware
      revision: v0.3
      import: app/west.yml
    - name: zmk-dongle-display
      remote: englmaxi
      revision: v0.3
      path: modules/zmk-dongle-display
    - name: zmk-new_corne
      remote: a741725193
      revision: main
      path: modules/eyelash_corne
  self:
    path: config
```
